/* usu-aoba rev.1 (https://github.com/sekigon-gonnoc/usu-aoba).
 *
 * Against rev.0: the 20-pin connector is unchanged; the extension connector
 * moved to pins of its own (it shared GPIO7-10 before) and two more were
 * added (not used by any keyboard here, so not defined); and the battery is
 * measured on a pin of its own. Values as in sekigon-gonnoc's own board
 * definition, zmk-component-usu-aoba usu_aoba_1_0_0.overlay. */
#define ACDB_EXT1_PIN1_GPIO &gpio0
#define ACDB_EXT1_PIN1_PORT 0
#define ACDB_EXT1_PIN1_NUMBER 23
#define ACDB_EXT1_PIN2_GPIO &gpio0
#define ACDB_EXT1_PIN2_PORT 0
#define ACDB_EXT1_PIN2_NUMBER 21
#define ACDB_EXT1_PIN3_GPIO &gpio1
#define ACDB_EXT1_PIN3_PORT 1
#define ACDB_EXT1_PIN3_NUMBER 14
#define ACDB_EXT1_PIN4_GPIO &gpio0
#define ACDB_EXT1_PIN4_PORT 0
#define ACDB_EXT1_PIN4_NUMBER 3

&acdb_ext1 {
	gpio-map = <1 0 ACDB_EXT1_PIN1_GPIO ACDB_EXT1_PIN1_NUMBER 0>,
		<2 0 ACDB_EXT1_PIN2_GPIO ACDB_EXT1_PIN2_NUMBER 0>,
		<3 0 ACDB_EXT1_PIN3_GPIO ACDB_EXT1_PIN3_NUMBER 0>,
		<4 0 ACDB_EXT1_PIN4_GPIO ACDB_EXT1_PIN4_NUMBER 0>;
};

/* AIN4 (P0.28): the battery itself, ahead of the boost converter. sekigon's
 * recommended NON_LIPO_MIN/MAX_MV for coin cells are the cells' own voltages
 * (2000 / 3000), so the pin sees the battery voltage with no divider to
 * correct for (not yet checked on a board). On a rev.0 board P0.28 is
 * connected to nothing; that is one more reason a rev.1 build must not go on
 * a rev.0 board. */
&vbatt {
	io-channels = <&adc 4>;
};
