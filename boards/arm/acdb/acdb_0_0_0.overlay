/* usu-aoba rev.0 -- the "ACDB" prototype this board definition started as.
 *
 * The 6-pin extension connector has no pins of its own: they are GPIO9, 10,
 * 7 and 8 of the 20-pin connector, in that order. A keyboard that uses the
 * connector cannot use those four in its matrix. */
#define ACDB_EXT1_PIN1_GPIO &gpio0
#define ACDB_EXT1_PIN1_PORT 0
#define ACDB_EXT1_PIN1_NUMBER 12
#define ACDB_EXT1_PIN2_GPIO &gpio1
#define ACDB_EXT1_PIN2_PORT 1
#define ACDB_EXT1_PIN2_NUMBER 9
#define ACDB_EXT1_PIN3_GPIO &gpio0
#define ACDB_EXT1_PIN3_PORT 0
#define ACDB_EXT1_PIN3_NUMBER 15
#define ACDB_EXT1_PIN4_GPIO &gpio0
#define ACDB_EXT1_PIN4_PORT 0
#define ACDB_EXT1_PIN4_NUMBER 13

&acdb_ext1 {
	gpio-map = <1 0 ACDB_EXT1_PIN1_GPIO ACDB_EXT1_PIN1_NUMBER 0>,
		<2 0 ACDB_EXT1_PIN2_GPIO ACDB_EXT1_PIN2_NUMBER 0>,
		<3 0 ACDB_EXT1_PIN3_GPIO ACDB_EXT1_PIN3_NUMBER 0>,
		<4 0 ACDB_EXT1_PIN4_GPIO ACDB_EXT1_PIN4_NUMBER 0>;
};

/* rev.0 has no pin wired to the battery. The original `<&adc 2>` read AIN2 =
 * P0.04, which is connected to nothing: a new CR2032 read 1%, and 0% even with
 * USB plugged in. 8 selects VDD (the module passes the number on as
 * NRF_SAADC_AIN0 + n, and the nRF52840's PSELP has AIN0..AIN7 = 1..8,
 * VDD = 9). That at least reads a real voltage, but VDD is after the boost
 * converter, so it says little about the battery: it is the same whether the
 * cells are new or nearly flat. */
&vbatt {
	io-channels = <&adc 8>;
};
