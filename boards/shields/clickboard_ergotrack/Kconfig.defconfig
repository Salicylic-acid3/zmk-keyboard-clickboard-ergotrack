## boards/shields/clickboard_ergotrack/Kconfig.defconfig
```kconfig
if SHIELD_CLICKBOARD_ERGOTRACK_LEFT || SHIELD_CLICKBOARD_ERGOTRACK_RIGHT

config ZMK_KEYBOARD_NAME
    default "ergotrack"

# USB の識別子(VID/PID/製造者/製品名)はここには書かない。default は ZMK 自身の
# 既定値に先を越されて一度も効かない。左右の .conf を見ること。

config ZMK_SPLIT
    default y

endif

if SHIELD_CLICKBOARD_ERGOTRACK_RIGHT

config ZMK_SPLIT_ROLE_CENTRAL
    default y

endif
```

## boards/shields/clickboard_ergotrack/Kconfig.shield
```kconfig
config SHIELD_CLICKBOARD_ERGOTRACK_LEFT
    def_bool $(shields_list_contains,clickboard_ergotrack_left)

config SHIELD_CLICKBOARD_ERGOTRACK_RIGHT
    def_bool $(shields_list_contains,clickboard_ergotrack_right)
```

## config/west.yml
```yaml
# --- 自分たちで書き換えるモジュールは、ブランチではなくコミットで固定する ---
#
# このリポジトリのCIは **このリポジトリへの push でしか走らない**。west.yml が
# `revision: <ブランチ名>` でモジュールを指していると、そのモジュールを直して
# push しても**ファームは一度もビルドされない**。緑のCIと最新のドライバが
# 別々に存在していて、焼いているのは古いほう、という状態になる。
# 実際に一晩これで溶かした: ドライバの修正を追いかけていたつもりで、
# ずっと修正前のファームを焼いていた。
#
# なので **Salicylic-acid3 の3つ(＝自分たちが書き換えるもの)はSHAで固定する。**
# こうするとドライバを直すたびにここも1行変える必要が生まれ、
# その1行が ErgoTrack へのコミットになり、CIが回る。**忘れようがなくなる。**
# ついでにビルドが再現可能になる(同じタグからいつでも同じ物が出る)。
#
# 更新のしかた:
#   git ls-remote --heads https://github.com/Salicylic-acid3/<repo>.git <branch>
# で出たSHAを下の revision に貼る。ブランチ名は隣のコメントに残してある。
#
# cormoran / sekigon-gonnoc 側をブランチ追従のままにしてあるのは、あちらは
# 自分たちが push する対象ではなく、追従をやめると上流の修正が届かなくなるため。
manifest:
  version: 1.2
  defaults:
    remote: cormoran
    revision: main
  remotes:
    - name: cormoran
      url-base: https://github.com/cormoran
    - name: sekigon-gonnoc
      url-base: https://github.com/sekigon-gonnoc
    - name: salicylic-acid3
      url-base: https://github.com/Salicylic-acid3
  projects:
    - name: zmk
      import: app/west.yml
      clone-depth: 1
      revision: main+dya
    # Required by cormoran/zmk#main+dya: patched Zephyr (also carries the
    # nRF half-duplex UART fixes this split keyboard's wired link needs).
    - name: zephyr
      revision: v4.1.0+zmk-fixes+nrf-half-duplex-uart
      clone-depth: 1
      import:
        name-blocklist:
          - ci-tools
          - hal_altera
          - hal_cypress
          - hal_infineon
          - hal_microchip
          - hal_nxp
          - hal_openisa
          - hal_xtensa
          - hal_st
          - hal_ti
          - loramac-node
          - mcuboot
          - mcumgr
          - net-tools
          - openthread
          - edtt
          - trusted-firmware-m
    - name: zmk-driver-iqs9151
      remote: salicylic-acid3
      # branch: ergotrack
      revision: bf094bf9d3cd1f89487229811699359e86da78b0
    - name: zmk-feature-non-lipo-battery-management
      remote: sekigon-gonnoc
      revision: main
    # --- Custom Studio Protocol: connection management ---
    - name: zmk-feature-custom-settings
    - name: zmk-module-ble-management
    - name: zmk-feature-os-detection
    - name: zmk-feature-default-layer
      revision: codex/custom-rpc-rewrite
      import: true
    # --- Custom Studio Protocol: macro & combo runtime editing ---
    - name: zmk-feature-runtime-macro
      import: true
    - name: zmk-feature-runtime-combo
      import: true
    # --- Custom Studio Protocol: tap dance runtime editing ---
    # 30%キーボードでキーを取り戻すための機能。タップ回数ごとの割り当てを
    # settings に置いてあるので、アプリから再ビルドなしで変えられる。
    - name: zmk-feature-runtime-tap-dance
      remote: salicylic-acid3
      # branch: master
      revision: df05361247f4d8582245f94b3389ad81fd7ad3ad
    # 左右それぞれの電池残量をアプリへ。ZMK本体はBLEのBattery Service経由でしか
    # 出さないので、USB接続だと見えない。不調を追っているときはUSBに繋いでいる。
    - name: zmk-feature-battery-report
      remote: salicylic-acid3
      # branch: master
      revision: c053460040e220323795a844bb6e23e55d850291
    # --- Custom Studio Protocol: diagnostics & device settings ---
    # (Keeb-On! Studio's Troubleshooting and Settings tabs.)
    - name: zmk-feature-device-info
    - name: zmk-feature-watchdog
    - name: zmk-feature-kscan-diagnostics
    - name: zmk-feature-input-stream
    - name: zmk-module-settings-rpc
    # --- Custom Studio Protocol: keymap fast load ---
    # 読み取り専用。BLE越しのキーマップ読み込みを速くするだけで、
    # 書き込み(編集・保存)は従来どおり公式プロトコルを通る。
    - name: zmk-feature-fast-keymap
    # キー以外の部品(トラックパッド)の位置をアプリへ伝えるための
    # カスタム Studio RPC。これが無いとキーマップ画面にパッドが描かれない。
    - name: zmk-feature-module-physical-layout
    # --- Custom Studio Protocol: トラックパッドのランタイム調整 ---
    # 感度・軸反転・カーソル⇔スクロール・回転・レイヤー別有効化をアプリから変える。
    # 名前が zmk-feature- ではなく zmk-module- なので注意。
    - name: zmk-module-runtime-input-processor
    # --- 調査用: キーボード自身のログとスタック使用量をアプリへ ---
    # Kconfig は既定で全部オフなので、ここに置いてあっても通常ビルドには
    # 何も入らない。build.yaml の *_devtool ビルドだけが有効にする。
    # Devtoolウィンドウで見えるようになるもの:
    #   - Zephyr のログ(LOG_WRN / LOG_ERR)がそのまま流れてくる。
    #     デバッグプローブ無しでファームの声を聞ける唯一の手段。
    #   - スレッドごとのスタックサイズと**高水位**。
    #     スタック不足を当てずっぽうで追う必要がなくなる。
    - name: zmk-module-devtool
  self:
    path: config
```
