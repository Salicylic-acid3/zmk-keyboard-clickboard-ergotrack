#include <dt-bindings/zmk/matrix_transform.h>
#include "clickboard_ergotrack-layouts.dtsi"

/ {
    chosen {
        zmk,kscan = &kscan0;
        zmk,physical-layout = &physical_layout0;
    };

    kscan0: kscan {
        compatible = "zmk,kscan-gpio-matrix";

        /* --- デバウンス: ClickBoard はマウススイッチを使う ---
         * マウススイッチはメカニカルキースイッチよりチャタリングしやすく、
         * 症状は「1回押したのに2文字入る」という形で出る。これは押下の
         * バウンスではなく、押している最中に一瞬離れたと判定されて再度
         * 押下になるもの。効くのは離しのデバウンスのほう。
         *
         * なので押下は既定の5msのまま、離しだけ20msにしてある。押下も20msに
         * すると全キーに20msの遅れが乗る。この基板は左右分離でただでさえ
         * 左手側の入力が遅れて届く(下の CONFIG_ZMK_SPLIT_BLE_PREF_LATENCY を
         * 見ること)ので、押下側に遅れを足すのは避けたい。
         *
         * まだ取りこぼすなら release を 30〜40ms まで上げる。上げすぎると
         * 速いタイプで2打目が消える(離してすぐ押し直すと同じキーの再押下が
         * デバウンス窓に飲まれる)ので、そこが上限の目安。
         */
        debounce-press-ms = <5>;
        debounce-release-ms = <20>;
    };

    default_transform: keymap_transform {
        compatible = "zmk,matrix-transform";
        rows = <7>;   /* 6行が実マトリクス、7行目はジェスチャー用の仮想位置 */
        columns = <12>;
        map = <
            RC(0,0)  /* 0,0 */
            RC(0,1)  /* 0,1 */
            RC(0,2)  /* 0,2 */
            RC(0,3)  /* 0,3 */
            RC(0,4)  /* 0,4 */
            RC(0,5)  /* 0,5 */
            RC(5,2)  /* 5,2 */
            RC(5,11)  /* 11,5 */
            RC(0,6)  /* 6,0 */
            RC(0,7)  /* 6,1 */
            RC(0,8)  /* 6,2 */
            RC(0,9)  /* 6,3 */
            RC(0,10)  /* 6,4 */
            RC(0,11)  /* 6,5 */
            RC(1,0)  /* 1,0 */
            RC(1,1)  /* 1,1 */
            RC(1,2)  /* 1,2 */
            RC(1,3)  /* 1,3 */
            RC(1,4)  /* 1,4 */
            RC(1,5)  /* 1,5 */
            RC(1,6)  /* 7,0 */
            RC(1,7)  /* 7,1 */
            RC(1,8)  /* 7,2 */
            RC(1,9)  /* 7,3 */
            RC(1,10)  /* 7,4 */
            RC(1,11)  /* 7,5 */
            RC(2,0)  /* 2,0 */
            RC(2,1)  /* 2,1 */
            RC(2,2)  /* 2,2 */
            RC(2,3)  /* 2,3 */
            RC(2,4)  /* 2,4 */
            RC(2,5)  /* 2,5 */
            RC(2,6)  /* 8,0 */
            RC(2,7)  /* 8,1 */
            RC(2,8)  /* 8,2 */
            RC(2,9)  /* 8,3 */
            RC(2,10)  /* 8,4 */
            RC(2,11)  /* 8,5 */
            RC(3,0)  /* 3,0 */
            RC(3,1)  /* 3,1 */
            RC(3,2)  /* 3,2 */
            RC(3,3)  /* 3,3 */
            RC(3,4)  /* 3,4 */
            RC(3,5)  /* 3,5 */
            RC(5,0)  /* 5,0 */
            RC(5,9)  /* 11,3 */
            RC(3,6)  /* 9,0 */
            RC(3,7)  /* 9,1 */
            RC(3,8)  /* 9,2 */
            RC(3,9)  /* 9,3 */
            RC(3,10)  /* 9,4 */
            RC(3,11)  /* 9,5 */
            RC(4,0)  /* 4,0 */
            RC(4,1)  /* 4,1 */
            RC(4,2)  /* 4,2 */
            RC(4,3)  /* 4,3 */
            RC(4,4)  /* 4,4 */
            RC(4,5)  /* 4,5 */
            RC(4,6)  /* 10,0 */
            RC(4,7)  /* 10,1 */
            RC(4,8)  /* 10,2 */
            RC(4,9)  /* 10,3 */
            RC(4,10)  /* 10,4 */
            RC(4,11)  /* 10,5 */
            RC(5,1)  /* 5,1 */
            RC(5,3)  /* 5,3 */
            RC(5,4)  /* 5,4 */
            RC(5,5)  /* 5,5 */
            RC(5,6)  /* 11,0 */
            RC(5,7)  /* 11,1 */
            RC(5,8)  /* 11,2 */
            RC(5,10)  /* 11,4 */

            /* --- kscanが絶対に出せない行6 = ジェスチャー用の仮想キー --- */
            RC(6,0)  /* pos72: 片手ピンチ (BTN_7) */
            RC(6,1)  /* pos73: 3本指スワイプ BTN_3 */
            RC(6,2)  /* pos74: 3本指スワイプ BTN_4 */
            RC(6,3)  /* pos75: 3本指スワイプ BTN_5 */
            RC(6,4)  /* pos76: 3本指スワイプ BTN_6 */
            RC(6,5)  /* pos77: 両手ズームの修飾キー (dual_pad) */
            RC(6,6)  /* pos78: 未使用 */
            RC(6,7)  /* pos79: 2本指横スワイプ (BTN_SIDE) */
            RC(6,8)  /* pos80: 2本指横スワイプ (BTN_EXTRA) */
        >;
    };
};
